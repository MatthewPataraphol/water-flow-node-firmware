## main/Kconfig.projbuild
```kconfig
menu "Water flow node"

choice FLOW_WIFI_AUTH_MODE
    prompt "Wi-Fi authentication mode"
    default FLOW_WIFI_AUTH_PERSONAL

config FLOW_WIFI_AUTH_PERSONAL
    bool "WPA/WPA2 Personal"

config FLOW_WIFI_AUTH_ENTERPRISE
    bool "WPA2-Enterprise (PEAP/MSCHAPv2)"
    select ESP_WIFI_ENTERPRISE_SUPPORT
    select ESP_WIFI_MBEDTLS_CRYPTO
    select ESP_WIFI_MBEDTLS_TLS_CLIENT
    select MBEDTLS_CERTIFICATE_BUNDLE

endchoice

config FLOW_WIFI_SSID
    string "Wi-Fi SSID (local secret configuration)"
    default ""

config FLOW_WIFI_PASSWORD
    string "Wi-Fi password (local secret configuration)"
    depends on FLOW_WIFI_AUTH_PERSONAL
    default ""
    help
        Saved in ignored sdkconfig and compiled into the firmware. Do not
        copy credentials into sdkconfig.defaults or commit build artifacts.

config FLOW_WIFI_ENTERPRISE_USERNAME
    string "Enterprise username (local secret configuration)"
    depends on FLOW_WIFI_AUTH_ENTERPRISE
    default ""
    help
        Inner PEAP/MSCHAPv2 username, 1-127 bytes. Also used as the outer
        identity unless an override is entered below. For PAL3.0 use your
        Purdue Career Account username. Never commit account credentials.

config FLOW_WIFI_ENTERPRISE_IDENTITY
    string "Enterprise outer identity override (blank uses username)"
    depends on FLOW_WIFI_AUTH_ENTERPRISE
    default ""
    help
        Optional outer EAP identity, 1-127 bytes when specified. Leave blank
        to use the username; other networks may require a separate identity.

config FLOW_WIFI_ENTERPRISE_PASSWORD
    string "Enterprise password (local secret configuration)"
    depends on FLOW_WIFI_AUTH_ENTERPRISE
    default ""
    help
        PEAP/MSCHAPv2 account password, not the Personal-mode Wi-Fi password.
        Saved in ignored sdkconfig and compiled into firmware. Never commit it.

config FLOW_WIFI_ENTERPRISE_SERVER_NAME
    string "Enterprise authentication-server certificate hostname (optional)"
    depends on FLOW_WIFI_AUTH_ENTERPRISE
    default ""
    help
        Recommended: the RADIUS/EAP server hostname provided by the network
        administrator, matching its certificate. This is a hostname check,
        not an Android-style domain suffix. Empty checks only the CA chain.
        The ESP-IDF certificate bundle is always used in Enterprise mode.

config FLOW_TB_HOST
    string "ThingsBoard MQTT hostname (no scheme or path)"
    default "mqtt.thingsboard.cloud"

config FLOW_TB_PORT
    int "ThingsBoard MQTT TLS port"
    range 1 65535
    default 8883

config FLOW_TB_TOKEN
    string "ThingsBoard device access token (local secret configuration)"
    default ""

config FLOW_HEARTBEAT_INTERVAL_S
    int "Heartbeat interval (seconds)"
    range 10 86400
    default 300

config FLOW_NTP_SERVER
    string "SNTP server"
    default "pool.ntp.org"

choice FLOW_SENSOR_SOURCE
    prompt "Sensor source"
    default FLOW_SENSOR_MOCK

config FLOW_SENSOR_MOCK
    bool "MOCK: alternate NO_FLOW and FLOW (test data)"

config FLOW_SENSOR_UART
    bool "UART: temporary FLOW/NO_FLOW line protocol"

config FLOW_SENSOR_ACCELEROMETER
    bool "SPI accelerometer interface (not implemented)"

endchoice

config FLOW_MOCK_INTERVAL_S
    int "Mock state interval (seconds)"
    depends on FLOW_SENSOR_MOCK
    range 1 86400
    default 30

config FLOW_UART_RX_GPIO
    int "UART1 RX GPIO (-1 means unconfigured)"
    depends on FLOW_SENSOR_UART
    range -1 39
    default -1
    help
        Adafruit ESP32 Feather V2 (ESP32-PICO-V3-02): labeled RX is GPIO7.
        One-way input: other ESP32 TX -> Feather RX/GPIO7, GND -> GND.
        The detected PICO-V3-02 allows GPIO7/8 but reserves flash GPIO6/11,
        PSRAM GPIO9/10, and unavailable/internal GPIO16/17/18/23.
        Console GPIO1/3 are blocked. Other ESP32 packages retain the generic
        GPIO6-11 block. RX=-1 remains unconfigured and will not start UART.

config FLOW_UART_TX_GPIO
    int "UART1 optional TX GPIO (-1 disables TX routing)"
    depends on FLOW_SENSOR_UART
    range -1 33
    default -1
    help
        Feather V2 labeled TX is GPIO8, available on ESP32-PICO-V3-02.
        Use -1 for one-way sensor input; use 8 only when TX routing is needed.
        TX must be output-capable, different from RX, and not reserved.

config FLOW_UART_BAUD
    int "UART baud rate (8N1, no flow control)"
    depends on FLOW_SENSOR_UART
    range 1200 921600
    default 115200

config FLOW_BATTERY_MOCK
    bool "Use MOCK battery readings"
    default y if FLOW_SENSOR_MOCK
    default n
    help
        Test values only. With this disabled, battery telemetry is null
        until the real hardware implementation is provided.

config FLOW_BATTERY_MOCK_MV
    int "Mock battery voltage (millivolts)"
    depends on FLOW_BATTERY_MOCK
    range 0 5000
    default 3910

config FLOW_BATTERY_MOCK_PERCENT
    int "Mock battery percentage"
    depends on FLOW_BATTERY_MOCK
    range 0 100
    default 78

endmenu
```
